## package/atheros-aquila-wpa2/Config.in
```kconfig
# Atheros hostap configuration

menu "Configuration"

config ATHEROS_AQUILA_WPA_ATHR_HOSTAP
	bool "Use Atheros latest hostap package"
	help
	  This is to use Atheros latest hostap package, which is derived
	  from the original hostap in w1.fi.

config ATHEROS_AQUILA_WPA_HOSTAPD
	depends on ATHEROS_AQUILA_WPA_ATHR_HOSTAP
	default y
	bool "Install hostapd"

config ATHEROS_AQUILA_WPA_WPASUPPLICANT
	depends on ATHEROS_AQUILA_WPA_ATHR_HOSTAP
	default n
	bool "Install wpa_supplicant"

endmenu
```

## package/atheros-enet/Config.in
```kconfig
# Atheros ethernet driver configuration

menu "Configurations"

config ATHEROS_ENET_BOARD
	string "Board that atheros-enet embedded"
	depends on PACKAGE_kmod-atheros-enet
	default "db120-wndr3700v4"

endmenu
```
